## soc/renesas/ra/ra2/Kconfig
```kconfig
# Copyright (c) 2024 MUNIC SA
# SPDX-License-Identifier: Apache-2.0

config SOC_SERIES_RA2
	bool
	select ARM
	select CPU_CORTEX_M23
	select CPU_HAS_ARM_MPU
	select CPU_CORTEX_M_HAS_SYSTICK
	select HAS_PM
	select PLATFORM_SPECIFIC_INIT
	select CLOCK_CONTROL
	select CUSTOM_GEN_ISR_TABLES
	help
	  Enable support for Renesas RA2 MCU series

if SOC_SERIES_RA2
config CUSTOM_GEN_ISR_TABLES
	bool

config CUSTOM_GEN_ISR_TABLES_PATH
	string
	default "${ZEPHYR_BASE}/soc/renesas/ra/ra2/scripts/gen_isr_tables.py"

config CUSTOM_GEN_ISR_TABLES_ARGS
	string
	default "--renesas-icu --debug"
endif
```
